## meta-lmp-bsp/conf/layer.conf
```bitbake
# We might have a conf and classes directory, append to BBPATH
BBPATH .= ":${LAYERDIR}"

# We have a recipes directory, add to BBFILES
BBFILES += "${LAYERDIR}/recipes*/*/*.bb ${LAYERDIR}/recipes*/*/*.bbappend"

BBFILE_COLLECTIONS += "meta-lmp-bsp"
BBFILE_PATTERN_meta-lmp-bsp := "^${LAYERDIR}/"
BBFILE_PRIORITY_meta-lmp-bsp = "9"

LAYERDEPENDS_meta-lmp-bsp = "core meta-lmp-base"
LAYERSERIES_COMPAT_meta-lmp-bsp = "kirkstone"

BBFILES_DYNAMIC += " \
    meta-arm:${LAYERDIR}/dynamic-layers/meta-arm/*/*/*.bb \
    meta-arm:${LAYERDIR}/dynamic-layers/meta-arm/*/*/*.bbappend \
    meta-ti-bsp:${LAYERDIR}/dynamic-layers/meta-ti-bsp/*/*/*.bb \
    meta-ti-bsp:${LAYERDIR}/dynamic-layers/meta-ti-bsp/*/*/*.bbappend \
    meta-ti-extras:${LAYERDIR}/dynamic-layers/meta-ti-extras/*/*/*.bb \
    meta-ti-extras:${LAYERDIR}/dynamic-layers/meta-ti-extras/*/*/*.bbappend \
    freescale-layer:${LAYERDIR}/dynamic-layers/freescale-layer/*/*/*.bb \
    freescale-layer:${LAYERDIR}/dynamic-layers/freescale-layer/*/*/*.bbappend \
    stm-st-stm32mp:${LAYERDIR}/dynamic-layers/stm-st-stm32mp/*/*/*.bb \
    stm-st-stm32mp:${LAYERDIR}/dynamic-layers/stm-st-stm32mp/*/*/*.bbappend \
    tegra:${LAYERDIR}/dynamic-layers/tegra/*/*/*.bb \
    tegra:${LAYERDIR}/dynamic-layers/tegra/*/*/*.bbappend \
    xilinx:${LAYERDIR}/dynamic-layers/xilinx/*/*/*.bb \
    xilinx:${LAYERDIR}/dynamic-layers/xilinx/*/*/*.bbappend \
    xilinx-standalone:${LAYERDIR}/dynamic-layers/xilinx-standalone/*/*/*.bb \
    xilinx-standalone:${LAYERDIR}/dynamic-layers/xilinx-standalone/*/*/*.bbappend \
    xilinx-tools:${LAYERDIR}/dynamic-layers/xilinx-tools/*/*/*.bb \
    xilinx-tools:${LAYERDIR}/dynamic-layers/xilinx-tools/*/*/*.bbappend \
"

# Override for external layers
LAYERSERIES_COMPAT_xilinx:append = " kirkstone"
LAYERSERIES_COMPAT_xilinx-bsp:append = " kirkstone"
LAYERSERIES_COMPAT_xilinx-standalone:append = " kirkstone"
LAYERSERIES_COMPAT_xilinx-tools:append = " kirkstone"

# ERROR: Parsing halted due to errors, see error messages above
# The variable dependency chain for the failure is: PACKAGE_ARCH -> MULTIMACH_TARGET_SYS -> WORKDIR -> S
BBMASK:append = " /meta-freescale/recipes-graphics/xwayland/xwayland_23.1.1.imx.bb"

# ERROR: No recipes in default available for:
BBMASK:append = " /meta-xilinx/meta-xilinx-standalone/recipes-devtools/gcc/gcc-source_12.%.bbappend"
```

## meta-lmp-bsp/conf/machine/kv260.conf
```bitbake
#@TYPE: Machine
#@NAME: kv260
#@DESCRIPTION: Machine support for Kria KV260 Vision AI Starter Kit customized for LmP

DEFAULTTUNE = "cortexa53"
SOC_VARIANT = "ev"

# Set MACHINEOVERRIDES manually instead of using BOARD / BOARD_VARIANT (now deprecated)
MACHINEOVERRIDES =. "k26:k26-kv:"

# Carriers are configured via overlays
UBOOT_DTBO_LOADADDRESS ?= "0x40100000"

# Build boot.scr for compatibility with the stock firmware
WKS_FILE_DEPENDS:append = " u-boot-ostree-scr"
IMAGE_BOOT_FILES:append = " boot.scr uEnv.txt"
# meta-kria drops u-boot-xlnx-uenv
EXTRA_IMAGEDEPENDS:remove = "u-boot-xlnx-uenv"
WKS_FILE_DEPENDS:remove = "u-boot-xlnx-uenv"
MACHINE_ESSENTIAL_EXTRA_RDEPENDS:remove = "u-boot-xlnx-uenv"

require conf/machine/include/zynqmp-lmp.inc

# require conf/machine/include/k26-smk.inc
HDF_MACHINE = "k26-kv"

# DSA file taken from xilinx-k26-starterkit-v2021.1-final.bsp
HDF_BASE = "file://"
HDF_PATH = "system.xsa"
HDF_EXT = "xsa"

YAML_SERIAL_CONSOLE_BAUDRATE = "115200"

# bitstream support
MACHINE_FIRMWARE:append = " fpga-manager-script"
MACHINE_EXTRA_RRECOMMENDS += "${MACHINE_FIRMWARE}"
SPL_FPGA_BINARY = "bitstream.bit.bin"
SPL_FPGA_LOAD_ADDR = "0x18000000"

# Make image-update essential as it is required for bootfw updates
MACHINE_ESSENTIAL_EXTRA_RDEPENDS += "image-update"

# SOM has infineon slb9670
MACHINE_FEATURES += "tpm2"
```
